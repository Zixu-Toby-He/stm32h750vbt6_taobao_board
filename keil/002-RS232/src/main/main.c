#include <stdlib.h>

#include "sys.h"
#include "delay.h"
#include "led.h"
#include "timer.h"

#include "sp232.h"


char msg[256] = {
	'\0','\0','\0','\0','\0','\0','\0','\0','\0','\0','\0','\0','\0','\0','\0','\0',
	'\0','\0','\0','\0','\0','\0','\0','\0','\0','\0','\0','\0','\0','\0','\0','\0',
	'\0','\0','\0','\0','\0','\0','\0','\0','\0','\0','\0','\0','\0','\0','\0','\0',
	'\0','\0','\0','\0','\0','\0','\0','\0','\0','\0','\0','\0','\0','\0','\0','\0',
	'\0','\0','\0','\0','\0','\0','\0','\0','\0','\0','\0','\0','\0','\0','\0','\0',
	'\0','\0','\0','\0','\0','\0','\0','\0','\0','\0','\0','\0','\0','\0','\0','\0',
	'\0','\0','\0','\0','\0','\0','\0','\0','\0','\0','\0','\0','\0','\0','\0','\0',
	'\0','\0','\0','\0','\0','\0','\0','\0','\0','\0','\0','\0','\0','\0','\0','\0',
	'\0','\0','\0','\0','\0','\0','\0','\0','\0','\0','\0','\0','\0','\0','\0','\0',
	'\0','\0','\0','\0','\0','\0','\0','\0','\0','\0','\0','\0','\0','\0','\0','\0',
	'\0','\0','\0','\0','\0','\0','\0','\0','\0','\0','\0','\0','\0','\0','\0','\0',
	'\0','\0','\0','\0','\0','\0','\0','\0','\0','\0','\0','\0','\0','\0','\0','\0',
	'\0','\0','\0','\0','\0','\0','\0','\0','\0','\0','\0','\0','\0','\0','\0','\0',
	'\0','\0','\0','\0','\0','\0','\0','\0','\0','\0','\0','\0','\0','\0','\0','\0',
	'\0','\0','\0','\0','\0','\0','\0','\0','\0','\0','\0','\0','\0','\0','\0','\0',
	'\0','\0','\0','\0','\0','\0','\0','\0','\0','\0','\0','\0','\0','\0','\0','\0'
};
uint8_t idx = 0;
void msghandler(uint8_t _msg_)
{
	msg[  idx] = _msg_;
	msg[++idx] = '\0';
	idx &= 0x7F;
}
float val = 0;


int main(void)
{
	uint8_t iter;

	Cache_Enable();
	HAL_Init();
	Stm32_Clock_Init(192, 5, 2, 2);
	delay_init(480);
	LED_Init();
	db9_init(115200, msghandler);
	LED0(0);

	while(1)
	{
		delay_ms(1);
		LED0_Toggle;
		sprintf(msg + 128, "msg: \"%s\"  val = %f   status = %i\r\n", msg, val, db9_get_status());
		if(idx != 0)
		{
			val = atof(msg);
			idx = 0;
			msg[0] = '\0';
		}
		for(iter = 0; msg[iter + 128] != '\0'; iter++)
		{
			db9_send(msg[iter + 128]);
		}
		delay_ms(1);
		LED0_Toggle;
    }
}

