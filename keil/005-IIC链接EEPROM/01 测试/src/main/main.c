#include <stdlib.h>

#include "system.h"
#include "delay.h"
#include "led.h"
#include "dac.h"

#include "sp232.h"
#include "ads8688.h"
#include "24cxx.h"

char msg[256] = {
	'\0', '\0', '\0', '\0', '\0', '\0', '\0', '\0', '\0', '\0', '\0', '\0', '\0', '\0', '\0', '\0',
	'\0', '\0', '\0', '\0', '\0', '\0', '\0', '\0', '\0', '\0', '\0', '\0', '\0', '\0', '\0', '\0',
	'\0', '\0', '\0', '\0', '\0', '\0', '\0', '\0', '\0', '\0', '\0', '\0', '\0', '\0', '\0', '\0',
	'\0', '\0', '\0', '\0', '\0', '\0', '\0', '\0', '\0', '\0', '\0', '\0', '\0', '\0', '\0', '\0',
	'\0', '\0', '\0', '\0', '\0', '\0', '\0', '\0', '\0', '\0', '\0', '\0', '\0', '\0', '\0', '\0',
	'\0', '\0', '\0', '\0', '\0', '\0', '\0', '\0', '\0', '\0', '\0', '\0', '\0', '\0', '\0', '\0',
	'\0', '\0', '\0', '\0', '\0', '\0', '\0', '\0', '\0', '\0', '\0', '\0', '\0', '\0', '\0', '\0',
	'\0', '\0', '\0', '\0', '\0', '\0', '\0', '\0', '\0', '\0', '\0', '\0', '\0', '\0', '\0', '\0',
	'\0', '\0', '\0', '\0', '\0', '\0', '\0', '\0', '\0', '\0', '\0', '\0', '\0', '\0', '\0', '\0',
	'\0', '\0', '\0', '\0', '\0', '\0', '\0', '\0', '\0', '\0', '\0', '\0', '\0', '\0', '\0', '\0',
	'\0', '\0', '\0', '\0', '\0', '\0', '\0', '\0', '\0', '\0', '\0', '\0', '\0', '\0', '\0', '\0',
	'\0', '\0', '\0', '\0', '\0', '\0', '\0', '\0', '\0', '\0', '\0', '\0', '\0', '\0', '\0', '\0',
	'\0', '\0', '\0', '\0', '\0', '\0', '\0', '\0', '\0', '\0', '\0', '\0', '\0', '\0', '\0', '\0',
	'\0', '\0', '\0', '\0', '\0', '\0', '\0', '\0', '\0', '\0', '\0', '\0', '\0', '\0', '\0', '\0',
	'\0', '\0', '\0', '\0', '\0', '\0', '\0', '\0', '\0', '\0', '\0', '\0', '\0', '\0', '\0', '\0',
	'\0', '\0', '\0', '\0', '\0', '\0', '\0', '\0', '\0', '\0', '\0', '\0', '\0', '\0', '\0', '\0'
};
uint8_t idx = 0;
void msghandler(uint8_t _msg_)
{
	msg[  idx] = _msg_;
	msg[++idx] = '\0';
	idx &= 0x7F;
}
float val = 0;

int main(void)
{
	uint8_t i;
	uint8_t temp;

	Cache_Enable();
	HAL_Init();
	MPU_Memory_Protection();
	SystemClock_Config();
	delay_init(DELAY_MODE_HLCK);
	LED_Init();
	db9_init(115200, msghandler);
	ADS8688_Init();
	AT24CXX_Init();
	LED0(1);


	while(AT24CXX_Check())// 检测不到24c02
	{
		delay_ms(5000);
		LED0_Toggle;      // DS0闪烁
	}
	db9_sendstr("AT24C02 detected\r\n");

	while(1)
	{
		LED0_Toggle;
		sprintf(msg + 128, "idx = %i\r\n", idx);
		db9_sendstr(msg + 128);
		*(msg + 128) = '\0';
		// 写入
		if (idx != 0)
		{
			for(i = 0; i < idx; i++)
			{
				AT24CXX_WriteOneByte(i, msg[i]);
			}
			AT24CXX_WriteOneByte(idx, '\0');
			idx = 0;
			msg[idx] = '\0';
			db9_sendstr("Write Successfully.\r\n");
		}
		// 读取
		i = 0;
		do
		{
			temp = AT24CXX_ReadOneByte(i);
			msg[   i  + 128] = temp;
			msg[(++i) + 128] = '\0';
		}
		while (temp);
		db9_send('c');
		db9_send('u');
		db9_send('r');
		db9_send('r');
		db9_send('e');
		db9_send('n');
		db9_send('t');
		db9_send(' ');
		db9_send('d');
		db9_send('a');
		db9_send('t');
		db9_send('a');
		db9_send(':');
		db9_send(' ');
		db9_send('\"');
		db9_sendstr(msg + 128);
		*(msg + 128) = 0;
		db9_send('\"');
		db9_send('\r');
		db9_send('\n');

		delay_ms(500);
		LED0_Toggle;
		delay_ms(500);
    }
}

